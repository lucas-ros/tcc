## qdec/build/Kconfig/arch/Kconfig
```kconfig
# Load Zephyr Arch Kconfig descriptions.
osource "/home/lucassorion/workspace/orion_dispenser/thirdparty/zephyrproject/zephyr/arch/x86/Kconfig"
osource "/home/lucassorion/workspace/orion_dispenser/thirdparty/zephyrproject/zephyr/arch/xtensa/Kconfig"
osource "/home/lucassorion/workspace/orion_dispenser/thirdparty/zephyrproject/zephyr/arch/sparc/Kconfig"
osource "/home/lucassorion/workspace/orion_dispenser/thirdparty/zephyrproject/zephyr/arch/riscv/Kconfig"
osource "/home/lucassorion/workspace/orion_dispenser/thirdparty/zephyrproject/zephyr/arch/posix/Kconfig"
osource "/home/lucassorion/workspace/orion_dispenser/thirdparty/zephyrproject/zephyr/arch/nios2/Kconfig"
osource "/home/lucassorion/workspace/orion_dispenser/thirdparty/zephyrproject/zephyr/arch/mips/Kconfig"
osource "/home/lucassorion/workspace/orion_dispenser/thirdparty/zephyrproject/zephyr/arch/arm64/Kconfig"
osource "/home/lucassorion/workspace/orion_dispenser/thirdparty/zephyrproject/zephyr/arch/arm/Kconfig"
osource "/home/lucassorion/workspace/orion_dispenser/thirdparty/zephyrproject/zephyr/arch/arc/Kconfig"
```

## qdec/build/Kconfig/boards/Kconfig
```kconfig
# Load Zephyr board Kconfig descriptions.
osource "/home/lucassorion/workspace/orion_dispenser/thirdparty/zephyrproject/zephyr/boards/st/nucleo_f410rb/Kconfig"
```

## qdec_count/build/Kconfig/boards/Kconfig.defconfig
```kconfig
# Load Zephyr board defconfig descriptions.
osource "/home/lucassorion/workspace/orion_dispenser/thirdparty/zephyrproject/zephyr/boards/st/nucleo_f410rb/Kconfig.defconfig"
```

## zephyr_m4/qdec_count_ab_ris_fal_v2/build/Kconfig/boards/Kconfig.nucleo_f410rb
```kconfig
# Load board Kconfig descriptions.
osource "/home/lucassorion/workspace/orion_dispenser/thirdparty/zephyrproject/zephyr/boards/st/nucleo_f410rb/Kconfig.nucleo_f410rb"
```
